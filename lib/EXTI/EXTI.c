/*********************************************************************************************************
* 模块名称：EXTI.c
* 摘    要：EXTI模块
* 当前版本：1.0.0
* 作    者：Leyutek(COPYRIGHT 2018 - 2021 Leyutek. All rights reserved.)
* 完成日期：2021年07月01日
* 内    容：
* 注    意：                                                                  
**********************************************************************************************************
* 取代版本：
* 作    者：
* 完成日期：
* 修改内容：
* 修改文件：
*********************************************************************************************************/

/*********************************************************************************************************
*                                              包含头文件
*********************************************************************************************************/
#include "EXTI.h"
#include "gd32f30x_conf.h"

/*********************************************************************************************************
*                                              宏定义
*********************************************************************************************************/

/*********************************************************************************************************
*                                              枚举结构体
*********************************************************************************************************/

/*********************************************************************************************************
*                                              内部变量定义
*********************************************************************************************************/

/*********************************************************************************************************
*                                              内部函数声明
*********************************************************************************************************/
static void ConfigEXTIGPIO(void);   //配置EXTI的GPIO 
static void ConfigEXTI(void);       //配置EXTI

/*********************************************************************************************************
*                                              内部函数实现
*********************************************************************************************************/
/*********************************************************************************************************
* 函数名称：ConfigEXTIGPIO
* 函数功能：配置EXTI的GPIO 
* 输入参数：void 
* 输出参数：void
* 返 回 值：void
* 创建日期：2021年07月01日
* 注    意：
*********************************************************************************************************/
static void ConfigEXTIGPIO(void)
{
  //使能RCU相关时钟
  rcu_periph_clock_enable(RCU_GPIOA);  //使能GPIOA的时钟
  rcu_periph_clock_enable(RCU_GPIOG);  //使能GPIOG的时钟
  
  gpio_init(GPIOA, GPIO_MODE_IPD, GPIO_OSPEED_50MHZ, GPIO_PIN_0);         //配置PA0为下拉输入
  gpio_init(GPIOG, GPIO_MODE_IPU, GPIO_OSPEED_50MHZ, GPIO_PIN_13);        //配置PG13为上拉输入
  gpio_init(GPIOG, GPIO_MODE_IPU, GPIO_OSPEED_50MHZ, GPIO_PIN_14);        //配置PG14为上拉输入
}

/*********************************************************************************************************
* 函数名称：ConfigEXTI
* 函数功能：配置EXTI
* 输入参数：void 
* 输出参数：void
* 返 回 值：void
* 创建日期：2021年07月01日
* 注    意：
*********************************************************************************************************/
static void ConfigEXTI(void)
{
  rcu_periph_clock_enable(RCU_AF); //使能AF时钟
 
  gpio_exti_source_select(GPIO_PORT_SOURCE_GPIOA, GPIO_PIN_SOURCE_0);   //连接EXTI0和PA0
  gpio_exti_source_select(GPIO_PORT_SOURCE_GPIOG, GPIO_PIN_SOURCE_13);  //连接EXTI13和PG13
  gpio_exti_source_select(GPIO_PORT_SOURCE_GPIOG, GPIO_PIN_SOURCE_14);  //连接EXTI14和PG14
  
  exti_init(EXTI_0, EXTI_INTERRUPT, EXTI_TRIG_RISING);    //配置中断线
  exti_init(EXTI_13, EXTI_INTERRUPT, EXTI_TRIG_FALLING);  //配置中断线
  exti_init(EXTI_14, EXTI_INTERRUPT, EXTI_TRIG_FALLING);  //配置中断线
  
  nvic_irq_enable(EXTI0_IRQn, 2, 2);       //使能外部中断线EXTI0并设置优先级
  nvic_irq_enable(EXTI10_15_IRQn, 2, 2);   //使能外部中断线EXTI13和EXTI14设置优先级

  exti_interrupt_flag_clear(EXTI_0);   //清除Line0上的中断标志位
  exti_interrupt_flag_clear(EXTI_13);  //清除Line13上的中断标志位
  exti_interrupt_flag_clear(EXTI_14);  //清除Line14上的中断标志位
}

/*********************************************************************************************************
* 函数名称：EXTI0IRQHandler
* 函数功能：EXTI0的中断服务函数，对应KEY1
* 输入参数：void 
* 输出参数：void
* 返 回 值：void
* 创建日期：2021年07月01日
* 注    意：
*********************************************************************************************************/
void EXTI0_IRQHandler(void)
{
  if(RESET != exti_interrupt_flag_get(EXTI_0)) 
  {
    //LED2状态取反
    gpio_bit_write(GPIOE, GPIO_PIN_6, (FlagStatus)(1 - gpio_output_bit_get(GPIOE, GPIO_PIN_6)));
    exti_interrupt_flag_clear(EXTI_0);  //清除Line0上的中断标志位
  }
}

/*********************************************************************************************************
* 函数名称：EXTI10_15_IRQHandler
* 函数功能：EXTI13/14的中断服务函数，对应KEY2/3
* 输入参数：void 
* 输出参数：void
* 返 回 值：void
* 创建日期：2021年07月01日
* 注    意：
*********************************************************************************************************/
void EXTI10_15_IRQHandler(void)
{
  if(RESET != exti_interrupt_flag_get(EXTI_13))
  {
    //LED2状态取反
    gpio_bit_write(GPIOE, GPIO_PIN_6, (FlagStatus)(1 - gpio_output_bit_get(GPIOE, GPIO_PIN_6)));
    exti_interrupt_flag_clear(EXTI_13);  //清除Line13上的中断标志位
  }
  
  if(RESET != exti_interrupt_flag_get(EXTI_14)) 
  {
    //LED1状态取反
    gpio_bit_write(GPIOA, GPIO_PIN_8, (FlagStatus)(1 - gpio_output_bit_get(GPIOA, GPIO_PIN_8)));

    //LED2状态取反
    gpio_bit_write(GPIOE, GPIO_PIN_6, (FlagStatus)(1 - gpio_output_bit_get(GPIOE, GPIO_PIN_6)));
    exti_interrupt_flag_clear(EXTI_14);  //清除Line14上的中断标志位
  }
}

/*********************************************************************************************************
*                                              API函数实现
*********************************************************************************************************/
/*********************************************************************************************************
* 函数名称：InitEXTI
* 函数功能：初始化EXTI模块
* 输入参数：void 
* 输出参数：void
* 返 回 值：void
* 创建日期：2018年1月1日
* 注    意：
*********************************************************************************************************/
void  InitEXTI(void)
{
  ConfigEXTIGPIO(); //配置EXTI的GPIO
  ConfigEXTI();     //配置EXTI
}
