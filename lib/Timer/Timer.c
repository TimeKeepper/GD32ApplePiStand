/*********************************************************************************************************
* 模块名称：Timer.c
* 摘    要：Timer模块
* 当前版本：1.0.0
* 作    者：Leyutek(COPYRIGHT 2018 - 2021 Leyutek. All rights reserved.)
* 完成日期：2021年07月01日  
* 内    容：
* 注    意：                                                                  
**********************************************************************************************************
* 取代版本：
* 作    者：
* 完成日期：
* 修改内容：
* 修改文件：
*********************************************************************************************************/

/*********************************************************************************************************
*                                              包含头文件
*********************************************************************************************************/
#include "Timer.h"
#include "gd32f30x_conf.h"

/*********************************************************************************************************
*                                              宏定义
*********************************************************************************************************/

/*********************************************************************************************************
*                                              枚举结构体
*********************************************************************************************************/

/*********************************************************************************************************
*                                              内部变量定义
*********************************************************************************************************/
static  unsigned char  s_i2msFlag  = 0;    //将2ms标志位的值设置为FALSE
static  unsigned char  s_i1secFlag = 0;    //将1s标志位的值设置为FALSE

/*********************************************************************************************************
*                                              内部函数声明
*********************************************************************************************************/
static  void  ConfigTimer2(unsigned short arr, unsigned short psc);  //配置TIMER2
static  void  ConfigTimer4(unsigned short arr, unsigned short psc);  //配置TIMER4

/*********************************************************************************************************
*                                              内部函数实现
*********************************************************************************************************/
/*********************************************************************************************************
* 函数名称：ConfigTimer2
* 函数功能：配置TIMER2 
* 输入参数：arr-自动重装值，psc-预分频器值
* 输出参数：void
* 返 回 值：void
* 创建日期：2021年07月01日
* 注    意：APB1时钟为60MHz，TIMER2和TIMER4时钟选择为APB1的2倍，因此，TIMER2和TIMER4时钟为120MHz
*********************************************************************************************************/
static  void ConfigTimer2(unsigned short arr, unsigned short psc)
{
  timer_parameter_struct timer_initpara;               //timer_initpara用于存放定时器的参数

  //使能RCU相关时钟 
  rcu_periph_clock_enable(RCU_TIMER2);                 //使能TIMER2的时钟

  timer_deinit(TIMER2);                                //设置TIMER2参数恢复默认值
  timer_struct_para_init(&timer_initpara);             //初始化timer_initpara

  //配置TIMER2
  timer_initpara.prescaler         = psc;              //设置预分频器值
  timer_initpara.counterdirection  = TIMER_COUNTER_UP; //设置向上计数模式
  timer_initpara.period            = arr;              //设置自动重装载值
  timer_initpara.clockdivision     = TIMER_CKDIV_DIV1; //设置时钟分割
  timer_init(TIMER2, &timer_initpara);                 //根据参数初始化定时器

  timer_interrupt_enable(TIMER2, TIMER_INT_UP);        //使能定时器的更新中断
  nvic_irq_enable(TIMER2_IRQn, 1, 0);                  //配置NVIC设置优先级
  timer_enable(TIMER2);                                //使能定时器
}

/*********************************************************************************************************
* 函数名称：ConfigTimer4
* 函数功能：配置TIMER4
* 输入参数：arr-自动重装值，psc-预分频器值
* 输出参数：void
* 返 回 值：void
* 创建日期：2021年07月01日
* 注    意：APB1时钟为60MHz，TIMER2和TIMER4时钟选择为APB1的2倍，因此，TIMER2和TIMER4时钟为120MHz
*********************************************************************************************************/
static  void ConfigTimer4(unsigned short arr, unsigned short psc)
{
  timer_parameter_struct timer_initpara;                //timer_initpara用于存放定时器的参数

  //使能RCU相关时钟
  rcu_periph_clock_enable(RCU_TIMER4);                  //使能TIMER4的时钟
 
  timer_deinit(TIMER4);                                 //设置TIMER4参数恢复默认值
  timer_struct_para_init(&timer_initpara);              //初始化timer_initpara
 
  //配置TIMER4
  timer_initpara.prescaler         = psc;               //设置预分频器值
  timer_initpara.counterdirection  = TIMER_COUNTER_UP;  //设置向上计数模式
  timer_initpara.period            = arr;               //设置自动重装载值
  timer_initpara.clockdivision     = TIMER_CKDIV_DIV1;  //设置时钟分割
  timer_init(TIMER4, &timer_initpara);                  //根据参数初始化定时器

  timer_interrupt_enable(TIMER4, TIMER_INT_UP);         //使能定时器的更新中断
  nvic_irq_enable(TIMER4_IRQn, 1, 0);                   //配置NVIC设置优先级

  timer_enable(TIMER4);                                 //使能定时器
}

/*********************************************************************************************************
* 函数名称：TIMER2_IRQHandler
* 函数功能：TIMER2中断服务函数 
* 输入参数：void
* 输出参数：void
* 返 回 值：void
* 创建日期：2021年07月01日
* 注    意：每毫秒进入一次中断服务函数
*********************************************************************************************************/
void TIMER2_IRQHandler(void)
{  
  static  unsigned short s_iCnt2 = 0;                              //定义一个静态变量s_iCnt2作为2ms计数器

  if(timer_interrupt_flag_get(TIMER2, TIMER_INT_FLAG_UP) == SET)   //判断定时器更新中断是否发生
  {
    timer_interrupt_flag_clear(TIMER2, TIMER_INT_FLAG_UP);         //清除定时器更新中断标志
  }

  s_iCnt2++;            //2ms计数器的计数值加1
                                
  if(s_iCnt2 >= 2)      //2ms计数器的计数值大于或等于2
  {                                                   
    s_iCnt2 = 0;        //重置2ms计数器的计数值为0
    s_i2msFlag = 1;  //将2ms标志位的值设置为TRUE 
  }
}

/*********************************************************************************************************
* 函数名称：TIMER4_IRQHandler
* 函数功能：TIMER4中断服务函数 
* 输入参数：void
* 输出参数：void
* 返 回 值：void
* 创建日期：2021年07月01日
* 注    意：每毫秒进入一次中断服务函数
*********************************************************************************************************/
void TIMER4_IRQHandler(void)  
{
  static  signed short s_iCnt1000  = 0;                            //定义一个静态变量s_iCnt1000作为1s计数器

  if (timer_interrupt_flag_get(TIMER4, TIMER_INT_FLAG_UP) == SET) //判断定时器更新中断是否发生
  {
    timer_interrupt_flag_clear(TIMER4, TIMER_INT_FLAG_UP);        //清除定时器更新中断标志 
  }                                                   
                                                      
  s_iCnt1000++;           //1000ms计数器的计数值加1
                                                      
  if(s_iCnt1000 >= 1000)  //1000ms计数器的计数值大于或等于1000
  {                                                   
    s_iCnt1000 = 0;       //重置1000ms计数器的计数值为0
    s_i1secFlag = 1;   //将1s标志位的值设置为TRUE
  } 
}

/*********************************************************************************************************
*                                              API函数实现
*********************************************************************************************************/
/*********************************************************************************************************
* 函数名称：InitTimer
* 函数功能：初始化Timer模块 
* 输入参数：void
* 输出参数：void
* 返 回 值：void
* 创建日期：2021年07月01日
* 注    意：使用的TIMER2和TIMER4由APB1(60MHz)预分频后输出。如果预分频为1，则由APB1*1输出，否则由APB1*2(120MHz)输出
*********************************************************************************************************/
void InitTimer(void)
{
  ConfigTimer2(999, 119);  //120MHz/(119+1)=1MHz，由0计数到999为1ms 
  ConfigTimer4(999, 119);  //120MHz/(119+1)=1MHz，由0计数到999为1ms
}

/*********************************************************************************************************
* 函数名称：Get2msFlag
* 函数功能：获取2ms标志位的值  
* 输入参数：void
* 输出参数：void
* 返 回 值：s_i2msFlag-2ms标志位的值
* 创建日期：2021年07月01日
* 注    意：
*********************************************************************************************************/
unsigned char  Get2msFlag(void)
{
  return(s_i2msFlag);     //返回2ms标志位的值
}

/*********************************************************************************************************
* 函数名称：Clr2msFlag
* 函数功能：清除2ms标志位  
* 输入参数：void
* 输出参数：void
* 返 回 值：void
* 创建日期：2021年07月01日
* 注    意：
*********************************************************************************************************/
void  Clr2msFlag(void)
{
  s_i2msFlag = 0;     //将2ms标志位的值设置为FALSE 
}

/*********************************************************************************************************
* 函数名称：Get1SecFlag
* 函数功能：获取1s标志位的值  
* 输入参数：void
* 输出参数：void
* 返 回 值：s_i1secFlag-1s标志位的值
* 创建日期：2021年07月01日
* 注    意：
*********************************************************************************************************/
unsigned char  Get1SecFlag(void)
{
  return(s_i1secFlag);    //返回1s标志位的值
}

/*********************************************************************************************************
* 函数名称：Clr1SecFlag
* 函数功能：清除1s标志位  
* 输入参数：void
* 输出参数：void
* 返 回 值：void
* 创建日期：2021年07月01日
* 注    意：
*********************************************************************************************************/
void  Clr1SecFlag(void)
{
  s_i1secFlag = 0;    //将1s标志位的值设置为FALSE
}
